/dts-v1/;
/plugin/;

/ {
  fragment@0 {
    target-path = "/";
    __overlay__ {
      led_0{
        compatible = "led_0";
        pinctrl-names = "default";
        gpios = <&rp1_gpio 21 0>;
        status = "okay";
      };
    };
  };
};
