/dts-v1/;
/plugin/;

/ {
  fragment@0 {
    target-path = "/";
    __overlay__ {
      gpio_21{
        compatible = "gpio_21";
        pinctrl-names = "default";
        gpios = <&rp1_gpio 21 0>;
        status = "okay";
      };
    };
  };
};
