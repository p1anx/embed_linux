/dts-v1/;
/plugin/;

/ {
  fragment@0 {
    target-path = "/";
    __overlay__ {
      led_gpio_14{
        compatible = "led_3";
        pinctrl-names = "default";
        gpios = <&rp1_gpio 14 0>;
        status = "okay";
      };
    };
  };
};
